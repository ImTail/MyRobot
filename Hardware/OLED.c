#include "stm32f10x.h"                  // Device header
#include <string.h>
#include "MyIIC.h"
#include "Delay.h"
#include "OLED.h"

uint8_t OLED_Datas_Buff[8][128];

const uint8_t OLED_Char_8x16[][16] = 
{
	
{0x00,0x00,0x00,0x00,0x00,0x00,0x00,0x00,0x00,0x00,0x00,0x00,0x00,0x00,0x00,0x00},/*" ",0*/

{0x00,0x00,0x00,0xF8,0x00,0x00,0x00,0x00,0x00,0x00,0x00,0x33,0x00,0x00,0x00,0x00},/*"!",1*/
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{0x00,0x02,0x01,0x02,0x02,0x04,0x02,0x00,0x00,0x00,0x00,0x00,0x00,0x00,0x00,0x00}/*"~",94*/
};

typedef struct chineseStr {
	char index[4];
	uint8_t datas[32];
} chineseStr;

const chineseStr OLED_Chinese[] = 
{
	{"你",{0x00,0x80,0x60,0xF8,0x07,0x40,0x20,0x18,0x0F,0x08,0xC8,0x08,0x08,0x28,0x18,0x00,0x01,0x00,0x00,0xFF,0x00,0x10,0x0C,0x03,0x40,0x80,0x7F,0x00,0x01,0x06,0x18,0x00}},
	{"好",{0x10,0x10,0xF0,0x1F,0x10,0xF0,0x00,0x80,0x82,0x82,0xE2,0x92,0x8A,0x86,0x80,0x00,0x40,0x22,0x15,0x08,0x16,0x61,0x00,0x00,0x40,0x80,0x7F,0x00,0x00,0x00,0x00,0x00}},
	{"这",{0x40,0x40,0x42,0xCC,0x00,0x08,0x28,0x48,0x89,0x0E,0xC8,0x38,0x08,0x08,0x00,0x00,0x00,0x40,0x20,0x1F,0x20,0x50,0x48,0x44,0x42,0x41,0x42,0x44,0x58,0x40,0x40,0x00}},
	{"里",{0x00,0x00,0xFE,0x92,0x92,0x92,0x92,0xFE,0x92,0x92,0x92,0x92,0xFE,0x00,0x00,0x00,0x40,0x40,0x44,0x44,0x44,0x44,0x44,0x7F,0x44,0x44,0x44,0x44,0x44,0x40,0x40,0x00}},
	{"是",{0x00,0x00,0x00,0x7F,0x49,0x49,0x49,0x49,0x49,0x49,0x49,0x7F,0x00,0x00,0x00,0x00,0x81,0x41,0x21,0x1D,0x21,0x41,0x81,0xFF,0x89,0x89,0x89,0x89,0x89,0x81,0x81,0x00}},
	{"语",{0x40,0x42,0xCC,0x00,0x00,0x82,0x92,0x92,0xF2,0x9E,0x92,0x92,0xF2,0x82,0x80,0x00,0x00,0x00,0x7F,0x20,0x10,0x00,0xFC,0x44,0x44,0x44,0x44,0x44,0xFC,0x00,0x00,0x00}},
	{"音",{0x40,0x40,0x44,0x44,0x54,0x64,0x45,0x46,0x44,0x64,0x54,0x44,0x44,0x40,0x40,0x00,0x00,0x00,0x00,0xFF,0x49,0x49,0x49,0x49,0x49,0x49,0x49,0xFF,0x00,0x00,0x00,0x00}},
	{"助",{0x00,0xFE,0x22,0x22,0x22,0xFE,0x00,0x00,0x10,0x10,0xFF,0x10,0x10,0xF0,0x00,0x00,0x20,0x3F,0x21,0x21,0x11,0x1F,0x90,0x40,0x20,0x18,0x47,0x80,0x40,0x3F,0x00,0x00}},
	{"手",{0x00,0x00,0x24,0x24,0x24,0x24,0x24,0xFC,0x22,0x22,0x22,0x23,0x22,0x00,0x00,0x00,0x02,0x02,0x02,0x02,0x02,0x42,0x82,0x7F,0x02,0x02,0x02,0x02,0x02,0x02,0x02,0x00}},
	{"",  {0x00,0x00,0x00,0x00,0x00,0x00,0x00,0x00,0x00,0x00,0x00,0x00,0x00,0x00,0x00,0x00,0x00,0x00,0x00,0x00,0x00,0x00,0x00,0x00,0x00,0x00,0x00,0x00,0x00,0x00,0x00,0x00}}
};

//IIC需要从机地址＋控制字节
void OLED_W_Command(uint8_t command)
{
	MyIIC_Start();
	MyIIC_W_Byte(0x78);	  		//从机地址,写。
	MyIIC_R_ACK();
	MyIIC_W_Byte(0x00);			//非连续模式，写命令。
	MyIIC_R_ACK();
	MyIIC_W_Byte(command);		//写入命令地址
	MyIIC_R_ACK();
	MyIIC_End();
}

void OLED_W_Data(uint8_t data)
{
	MyIIC_Start();
	MyIIC_W_Byte(0x78);	  		//从机地址，写。
	MyIIC_R_ACK();
	MyIIC_W_Byte(0x40);			//非连续模式，写数据。
	MyIIC_R_ACK();
	MyIIC_W_Byte(data);			//写入的数据
	MyIIC_R_ACK();
	MyIIC_End();
}

void OLED_W_Datas(uint8_t* datas,uint16_t count)
{
	MyIIC_Start();
	MyIIC_W_Byte(0x78);	  		//从机地址，写。
	MyIIC_R_ACK();
	MyIIC_W_Byte(0x40);			//非连续模式，写数据。
	MyIIC_R_ACK();
	
	for (uint8_t i = 0 ; i < count ; i++)//写入多次数据
	{
		MyIIC_W_Byte(datas[i]);			
		MyIIC_R_ACK();
	}
	MyIIC_End();
}

//参考手册中推荐启动流程。
void OLED_Init(void) 	
{
	MyIIC_Init();
	
	//初始化显存数组
	for (int i = 0 ; i < 8 ; i++)
	{
		for (int j = 0 ; j < 128 ; j++)
		{
			OLED_Datas_Buff[i][j]=0x00;
		}
	}
	
	Delay_ms(100);
	
	OLED_W_Command(0xAE);		//命令，设置显示关闭
	
	OLED_W_Command(0xD5);		//命令，设置分频
	OLED_W_Command(0x80);		//命令，设置时钟频率
	
	OLED_W_Command(0xA8);		//命令，设置多路复用比率
	OLED_W_Command(0x3F);
	
	OLED_W_Command(0xD3);		//命令，设置显示偏移
	OLED_W_Command(0x00);
	
	OLED_W_Command(0x40);		//命令，设置开始行
	
	OLED_W_Command(0xA1);		//命令，设置段重新映射
	
	OLED_W_Command(0xC8);		//命令，设置端口输出扫描方向
		
	OLED_W_Command(0xDA);		//命令，设置端口引脚硬件配置
	OLED_W_Command(0x12);
	
	OLED_W_Command(0x81);		//命令，设置对比度控制
	OLED_W_Command(0xCF);
	
	OLED_W_Command(0xD9);		//命令，设置预充电周期
	OLED_W_Command(0xF1);
	
	OLED_W_Command(0xD8);		//命令，设置VCOMH取消选择级别
	OLED_W_Command(0x30);
	
	OLED_W_Command(0xA4);		//命令，设置完整显示打开
	
	OLED_W_Command(0xA6);		//命令，设置正常显示/反色显示
	
	OLED_W_Command(0x8D);		//命令，设置电荷泵，按需。
	OLED_W_Command(0x14);
	
	OLED_W_Command(0xAF);		//命令，设置打开显示
	
	Delay_ms(100);
}


void OLED_SetCursor(uint8_t x,uint8_t page)
{
	//命令0x0N中N代表X坐标低位，命令0x1N中N代表X坐标高位，
	OLED_W_Command(0x00 | (x&0x0F));		//将x的低4位放入0x0N命令中
	OLED_W_Command(0x10 | ((x&0xF0)>>4));	//将x的高4位放入0x1N命令中
	OLED_W_Command(0xB0 | (page&0x07));		//指定页地址，只有低三位用于放置页地址
	
}

//检查输入的区域是否超出了屏幕范围
uint8_t OLED_CheckSize(uint8_t x,uint8_t y,uint8_t width,uint8_t height)
{
	if (x+width-1>127 || y+height-1>64)
	{
		return 1;
	} else 
	{
		return 0;
	}
}

void OLED_FlushAll(void) 
{
	for (int i = 0 ; i < 8 ; i++)
	{
		OLED_SetCursor(0,i);
		OLED_W_Datas(OLED_Datas_Buff[i],128);
	}
	
}

//按照起始页和列，根据跨越的页数量和列数量进行刷新屏幕，减少运算资源浪费。
void OLED_FlushZoom(uint8_t x,uint8_t page,uint8_t width,uint8_t pageCount)
{
	
	//若区域超出屏幕范围，则退出函数
	if (OLED_CheckSize(x,page*8,width,pageCount*8))
	{
		return;
	}
	
	
	for (uint8_t i = 0 ; i < pageCount ; i++)
	{
		
		OLED_SetCursor(x,page+i);
		OLED_W_Datas(&OLED_Datas_Buff[page+i][x],width);//取该页的第N个元素的地址，作为指针传入，方便偏移写入。
	}
	
}

//清屏函数，写入最后一个字节，会自动回到第一行第一列。
void OLED_ClearAll(void)
{
	OLED_FlushAll();
}



//写入8x16的数据需要用到两页 像素0~127 0~63 每page代表8行 page:0~7。规定一行为2页16个像素，一列为8个像素，即将屏幕分成了4x16的显示空间。
void OLED_ShowChar(uint8_t column,uint8_t line,char ch)
{
	
	uint8_t x = column*8;
	uint8_t p = line*2;
	
	if (OLED_CheckSize(x,p*8,8,16) || ch < ' ' || ch > '~')
	{
		return;
	}
	
	for (uint8_t i = 0 ; i < 8 ;i++)
	{
		OLED_Datas_Buff[p][x+i] |= OLED_Char_8x16[ch-' '][i];
		
	}
	
	for (uint8_t i = 0 ; i < 8 ;i++)
	{
		OLED_Datas_Buff[p+1][x+i] |= OLED_Char_8x16[ch-' '][i+8];
	}
	
	OLED_FlushZoom(x,p,8,2);
	//OLED_FlushAll();//严重影响速度
}


void OLED_ShowString(uint8_t column,uint8_t line,char* str,uint8_t len)
{
	for (uint8_t i = 0 ; i < len ; i++)
	{
		OLED_ShowChar(column,line,str[i]);
		column++;
	}
}

//传入(uint8_t *)img二维数组转换后的地址，传入的每一项代表每一行的数据，暂未实现偏移刷新，y值在哪一页就判定y起始地址为页起始地址。
void OLED_Show_Img(uint8_t x,uint8_t y,uint8_t* datas,uint8_t width,uint8_t height,uint8_t cover)
{
	if (OLED_CheckSize(x,y,width,height))
	{
		return;
	}
	uint8_t page = y/8;
	uint8_t pageCount = height%8==0 ? (height/8):(height/8+1);
	
	for (uint8_t i = 0 ; i < pageCount ; i++)
	{
		OLED_SetCursor(x,page+i);
		for (uint8_t j = 0 ; j < width ; j++)
		{
			if (cover == 0)
			{
				OLED_Datas_Buff[page+i][x+j] |= *(datas+i*width+j);
			} else 
			{
				OLED_Datas_Buff[page+i][x+j] = *(datas+i*width+j);
			}
			
		}
	}
	
	OLED_FlushZoom(x,page,width,pageCount);
}

void OLED_ShowChinese(uint8_t x,uint8_t y,char* chineseChar)
{
	if (OLED_CheckSize(x,y,16,16))
	{
		return;
	}
	uint8_t page = y/8;									
	for (uint8_t j = 0 ;  ; j++)										//遍历中文库，查找对应的中文字节(当前编码，中文是三个字节)
	{
		if (strcmp(OLED_Chinese[j].index,chineseChar)==0 || strcmp(OLED_Chinese[j].index,"")==0)//若该项等于输入的汉字字符串，或者等于最后一项
		{
			for (uint8_t k = 0 ; k < 16 ; k++)
			{
				OLED_Datas_Buff[page][x+k] = OLED_Chinese[j].datas[k];
			}
			for (uint8_t k = 0 ; k < 16 ; k++)
			{
				OLED_Datas_Buff[page+1][x+k] = OLED_Chinese[j].datas[k+16];
			}
			break;
		}
	}
	
	
	OLED_FlushAll();
	
}
